## config/west.yml
```yaml
manifest:
  remotes:
    - name: zmkfirmware
      url-base: https://github.com/zmkfirmware
    - name: refil
      url-base: https://github.com/refil
    - name: chaoy
      url-base: https://github.com/chaoy
  projects:
    - name: zmk
      remote: chaoy
      revision: claude/fix-keymap-reserved-layers-wqgu5
      import: app/west.yml
  self:
    path: config
```
